## S3-CAM-Hub/main/Kconfig.projbuild
```kconfig
menu "S3 Vision Hub Configuration"

    menu "Wi-Fi"
        config VH_WIFI_SSID
            string "Wi-Fi SSID"
            default "mywifi"
            help
                SSID of the Wi-Fi network to connect to.

        config VH_WIFI_PASSWORD
            string "Wi-Fi Password"
            default "mypassword"
            help
                Password for the Wi-Fi network.

        config VH_WIFI_RECONNECT_DELAY_MS
            int "Reconnect delay (ms)"
            default 3000
            range 500 30000
            help
                Delay between Wi-Fi reconnection attempts.

        config VH_WIFI_MAX_RETRY
            int "Max reconnect retries before reboot"
            default 20
            range 5 100
    endmenu

    menu "Camera"
        config VH_CAM_FRAME_SIZE
            int "Camera frame size (FRAMESIZE_* enum value)"
            default 7
            help
                Actual FRAMESIZE enum (espressif__esp32-camera):
                4=QVGA(320x240), 5=CIF(400x296), 6=HVGA(480x320),
                7=VGA(640x480), 8=SVGA(800x600), 9=XGA(1024x768),
                10=HD(1280x720), 11=SXGA(1280x1024), 12=UXGA(1600x1200).
                Default 7 = VGA 640x480. Best for 15+ fps WiFi streaming.
                HD (10) needs ~180KB DMA buffer and ~3MB/s WiFi — not suitable.

        config VH_CAM_JPEG_QUALITY
            int "JPEG quality (0=best/largest, 63=worst/smallest)"
            default 20
            range 0 63

        config VH_CAM_FB_COUNT
            int "Camera frame buffer count (in PSRAM)"
            default 3
            range 2 6
    endmenu

    menu "Web / Authentication"
        comment "DEV CREDENTIALS - replace before any production deployment"

        config VH_WEB_USERNAME
            string "Admin panel username"
            default "tenten"

        config VH_WEB_PASSWORD
            string "Admin panel password"
            default "1234"

        config VH_WEB_PORT
            int "HTTP server port"
            default 80
            range 1 65535
    endmenu

    menu "Telegram Alerts"
        config VH_TELEGRAM_ENABLED
            bool "Enable Telegram alert transport"
            default n

        config VH_TELEGRAM_BOT_TOKEN
            string "Telegram bot token"
            default ""
            depends on VH_TELEGRAM_ENABLED
            help
                Bot token from @BotFather.

        config VH_TELEGRAM_CHAT_ID
            string "Telegram chat ID"
            default ""
            depends on VH_TELEGRAM_ENABLED
    endmenu

    menu "Alarm Thresholds"
        config VH_ALARM_TEMP_HIGH_C
            int "High temperature alarm threshold (deg C)"
            default 60
            range 30 120

        config VH_ALARM_CO_HIGH_PPM
            int "High CO alarm threshold (ppm)"
            default 50
            range 10 500

        config VH_ALARM_COOLDOWN_S
            int "Alarm cooldown period (seconds)"
            default 60
            range 10 3600
    endmenu

    menu "Sensor"
        config VH_SENSOR_POLL_MS
            int "Sensor poll interval (ms)"
            default 1000
            range 100 60000
    endmenu

    menu "MQ Gas Sensor Calibration"
        config VH_MQ7_R0_KOHM_X10
            int "MQ7 R0 resistance x10 (kOhm*10, e.g. 100 = 10.0 kOhm)"
            default 100
            range 10 1000
            help
                Sensor resistance in clean air. Calibrate by measuring Rs
                after 24h warm-up in clean air, then update this value.

        config VH_MQ137_R0_KOHM_X10
            int "MQ137 R0 resistance x10 (kOhm*10)"
            default 100
            range 10 1000
    endmenu

    menu "BIST Logger"
        config VH_BIST_LOG_INTERVAL_S
            int "BIST log interval (seconds)"
            default 60
            range 10 3600
    endmenu

endmenu
```

## S3-CAM-Hub/sdkconfig.defaults
```kconfig
# sdkconfig.defaults — ESP32-S3 N16R8 / s3_vision_hub
# Applied automatically by idf.py if no sdkconfig exists.
# Settings here override ESP-IDF defaults for this target.

# ── Target ────────────────────────────────────────────────────────────────────
CONFIG_IDF_TARGET="esp32s3"

# ── CPU ───────────────────────────────────────────────────────────────────────
CONFIG_ESP_DEFAULT_CPU_FREQ_MHZ_240=y
CONFIG_FREERTOS_HZ=1000

# ── PSRAM (Octal, 8 MB, 80 MHz) ───────────────────────────────────────────────
CONFIG_SPIRAM=y
CONFIG_SPIRAM_MODE_OCT=y
CONFIG_SPIRAM_SPEED_80M=y
CONFIG_SPIRAM_USE_MALLOC=y
CONFIG_SPIRAM_MALLOC_ALWAYSINTERNAL=8192
CONFIG_SPIRAM_IGNORE_NOTFOUND=n
CONFIG_SPIRAM_TRY_ALLOCATE_WIFI_LWIP=y

# ── Flash ─────────────────────────────────────────────────────────────────────
CONFIG_ESPTOOLPY_FLASHSIZE_16MB=y
CONFIG_PARTITION_TABLE_CUSTOM=y
CONFIG_PARTITION_TABLE_CUSTOM_FILENAME="partitions.csv"

# ── FreeRTOS ──────────────────────────────────────────────────────────────────
CONFIG_FREERTOS_UNICORE=n
CONFIG_ESP_MAIN_TASK_STACK_SIZE=8192
CONFIG_FREERTOS_GENERATE_RUN_TIME_STATS=y
CONFIG_FREERTOS_USE_TRACE_FACILITY=y
# Use esp_timer (1 MHz, µs) for runtime stats.
# CPU_CLK mode returns total_runtime=0 in ESP-IDF v5 SMP — unusable for delta%.
CONFIG_FREERTOS_RUN_TIME_STATS_USING_ESP_TIMER=y

# ── Wi-Fi ─────────────────────────────────────────────────────────────────────
CONFIG_ESP_WIFI_STATIC_RX_BUFFER_NUM=10
CONFIG_ESP_WIFI_DYNAMIC_RX_BUFFER_NUM=32
CONFIG_ESP_WIFI_AMPDU_RX_ENABLED=y
CONFIG_ESP_WIFI_AMPDU_TX_ENABLED=y

# ── Networking ────────────────────────────────────────────────────────────────
# max_open_sockets (13) + 1 listening socket = 14 needed.
# Default LWIP_MAX_SOCKETS=10 → httpd_start() silently fails. Set to 16.
CONFIG_LWIP_MAX_SOCKETS=16
# 64 KB send buffer: one full JPEG frame (~30-70 KB) fits in a single kernel
# call. With the default 5760 bytes, httpd_resp_sendstr() blocks mid-response
# while iOS slowly ACKs — the httpd task freezes, starving all other requests.
# 65535 is the maximum allowed by the Kconfig range (2440-65535 without
# WND_SCALE). 131072 exceeds that range and is silently rejected → stays 5760.
# NOTE: TCP_SNDLOWAT = SND_BUF/2 must fit in u16_t (< 59775); 65535/2=32767 ✓
CONFIG_LWIP_TCP_SND_BUF_DEFAULT=65535
CONFIG_LWIP_TCP_WND_DEFAULT=65535
CONFIG_LWIP_TCP_RECVMBOX_SIZE=12
CONFIG_LWIP_UDP_RECVMBOX_SIZE=6
CONFIG_LWIP_TCPIP_RECVMBOX_SIZE=32
CONFIG_LWIP_TCPIP_TASK_STACK_SIZE=4096

# ── HTTP Server ───────────────────────────────────────────────────────────────
CONFIG_HTTPD_MAX_REQ_HDR_LEN=1024
CONFIG_HTTPD_MAX_URI_LEN=512
CONFIG_HTTPD_ERR_RESP_NO_DELAY=y
# WebSocket support for /ws/stream push-based video broadcaster.
CONFIG_HTTPD_WS_SUPPORT=y

# ── Logging ───────────────────────────────────────────────────────────────────
CONFIG_LOG_DEFAULT_LEVEL_INFO=y
CONFIG_LOG_MAXIMUM_LEVEL_DEBUG=y

# ── Watchdog ──────────────────────────────────────────────────────────────────
CONFIG_ESP_TASK_WDT_EN=y
CONFIG_ESP_TASK_WDT_INIT=y
CONFIG_ESP_TASK_WDT_TIMEOUT_S=10
CONFIG_ESP_TASK_WDT_PANIC=y

# ── NVS ───────────────────────────────────────────────────────────────────────
CONFIG_NVS_ASSERT_ERROR_CHECK=n

# ── Wi-Fi credentials ─────────────────────────────────────────────────────────
CONFIG_VH_WIFI_SSID="localhost-ofc-dev0"
CONFIG_VH_WIFI_PASSWORD="1994Far.?!1994Far.?!"

# ── Camera ────────────────────────────────────────────────────────────────────
# framesize_t enum (espressif__esp32-camera sensor.h):
#   7  = FRAMESIZE_320X320  (320×320)
#   10 = FRAMESIZE_VGA      (640×480)  ← target
#   11 = FRAMESIZE_SVGA     (800×600)
# HD (FRAMESIZE_HD=13, 1280×720) needs >180KB DMA and ~10Mbps — not feasible.
CONFIG_VH_CAM_FRAME_SIZE=10
CONFIG_OV3660_SUPPORT=y
# Pin camera DMA task to Core 1 (same as stream_task, motion_detect).
# Core 0 must remain free for WiFi/LWIP/httpd — they share bus with camera GDMA.
CONFIG_CAMERA_CORE1=y
# VGA (640×480) quality=35 for snapshot polling.
# At PCLK=10 MHz hardware produces ~25 fps. JPEG ~40-70 KB/frame at quality=35.
# 10fps × 55KB = 550KB/s = 4.4 Mbps — within ESP32-S3 Wi-Fi TCP throughput.
CONFIG_VH_CAM_JPEG_QUALITY=35
# 3 frame buffers for CAMERA_GRAB_WHEN_EMPTY.
# With 3 buffers: DMA fills 2 while app holds 1 → fb_get() returns immediately.
# 3 × 160KB = 480KB PSRAM for camera buffers.
CONFIG_VH_CAM_FB_COUNT=3

# ── Camera JPEG DMA buffer ─────────────────────────────────────────────────────
# VGA quality=35 JPEG = 40-70 KB typical, 100 KB worst-case.
# 160 KB gives comfortable headroom. 3 × 160 KB = 480 KB PSRAM total.
CONFIG_CAMERA_JPEG_MODE_FRAME_SIZE_CUSTOM=y
CONFIG_CAMERA_JPEG_MODE_FRAME_SIZE=163840

# ── SPI (W25Q64 external flash) ───────────────────────────────────────────────
CONFIG_SPI_MASTER_IN_IRAM=y
```

## sdkconfig.defaults
```kconfig
# sdkconfig.defaults — ESP32-S3 N16R8 / s3_vision_hub
# Applied automatically by idf.py if no sdkconfig exists.
# Settings here override ESP-IDF defaults for this target.

# ── Target ────────────────────────────────────────────────────────────────────
CONFIG_IDF_TARGET="esp32s3"

# ── CPU ───────────────────────────────────────────────────────────────────────
CONFIG_ESP_DEFAULT_CPU_FREQ_MHZ_240=y
CONFIG_FREERTOS_HZ=1000

# ── PSRAM (Octal, 8 MB, 80 MHz) ───────────────────────────────────────────────
CONFIG_SPIRAM=y
CONFIG_SPIRAM_MODE_OCT=y
CONFIG_SPIRAM_SPEED_80M=y
CONFIG_SPIRAM_USE_MALLOC=y
CONFIG_SPIRAM_MALLOC_ALWAYSINTERNAL=8192
CONFIG_SPIRAM_IGNORE_NOTFOUND=n
CONFIG_SPIRAM_TRY_ALLOCATE_WIFI_LWIP=y

# ── Flash ─────────────────────────────────────────────────────────────────────
CONFIG_ESPTOOLPY_FLASHSIZE_16MB=y
CONFIG_PARTITION_TABLE_CUSTOM=y
CONFIG_PARTITION_TABLE_CUSTOM_FILENAME="partitions.csv"

# ── FreeRTOS ──────────────────────────────────────────────────────────────────
CONFIG_FREERTOS_UNICORE=n
CONFIG_ESP_MAIN_TASK_STACK_SIZE=8192
CONFIG_FREERTOS_GENERATE_RUN_TIME_STATS=y
CONFIG_FREERTOS_USE_TRACE_FACILITY=y
# Use esp_timer (1 MHz, µs) for runtime stats.
# CPU_CLK mode returns total_runtime=0 in ESP-IDF v5 SMP — unusable for delta%.
CONFIG_FREERTOS_RUN_TIME_STATS_USING_ESP_TIMER=y

# ── Wi-Fi ─────────────────────────────────────────────────────────────────────
CONFIG_ESP_WIFI_STATIC_RX_BUFFER_NUM=10
CONFIG_ESP_WIFI_DYNAMIC_RX_BUFFER_NUM=32
CONFIG_ESP_WIFI_AMPDU_RX_ENABLED=y
CONFIG_ESP_WIFI_AMPDU_TX_ENABLED=y

# ── Networking ────────────────────────────────────────────────────────────────
# max_open_sockets (13) + 1 listening socket = 14 needed.
# Default LWIP_MAX_SOCKETS=10 → httpd_start() silently fails. Set to 16.
CONFIG_LWIP_MAX_SOCKETS=16
# 128 KB send buffer: one full VGA JPEG frame (50-90 KB) fits in one shot.
# Without this, a 90 KB frame requires 2 send() calls; if the second blocks
# (phone's window full), the stream freezes until SO_SNDTIMEO fires.
CONFIG_LWIP_TCP_SND_BUF_DEFAULT=131072
CONFIG_LWIP_TCP_WND_DEFAULT=131072
CONFIG_LWIP_TCP_RECVMBOX_SIZE=12
CONFIG_LWIP_UDP_RECVMBOX_SIZE=6
CONFIG_LWIP_TCPIP_RECVMBOX_SIZE=32
CONFIG_LWIP_TCPIP_TASK_STACK_SIZE=4096

# ── HTTP Server ───────────────────────────────────────────────────────────────
CONFIG_HTTPD_MAX_REQ_HDR_LEN=1024
CONFIG_HTTPD_MAX_URI_LEN=512
CONFIG_HTTPD_ERR_RESP_NO_DELAY=y

# ── Logging ───────────────────────────────────────────────────────────────────
CONFIG_LOG_DEFAULT_LEVEL_INFO=y
CONFIG_LOG_MAXIMUM_LEVEL_DEBUG=y

# ── Watchdog ──────────────────────────────────────────────────────────────────
CONFIG_ESP_TASK_WDT_EN=y
CONFIG_ESP_TASK_WDT_INIT=y
CONFIG_ESP_TASK_WDT_TIMEOUT_S=10
CONFIG_ESP_TASK_WDT_PANIC=y

# ── NVS ───────────────────────────────────────────────────────────────────────
CONFIG_NVS_ASSERT_ERROR_CHECK=n

# ── Wi-Fi credentials ─────────────────────────────────────────────────────────
CONFIG_VH_WIFI_SSID="localhost-ofc-dev0"
CONFIG_VH_WIFI_PASSWORD="1994Far.?!1994Far.?!"

# ── Camera ────────────────────────────────────────────────────────────────────
# Frame size 7 = VGA (640x480). HD(10) = 1280x720 requires 180KB DMA buffer
# and ~3MB/s WiFi — neither is achievable. VGA at quality 20 fits in 96KB.
CONFIG_VH_CAM_FRAME_SIZE=7
CONFIG_OV3660_SUPPORT=y
# Pin camera DMA task to Core 1 (same as stream_task, motion_detect).
# Core 0 must remain free for WiFi/LWIP/httpd — they share bus with camera GDMA.
CONFIG_CAMERA_CORE1=y
# VGA (640×480) quality=25 for MJPEG streaming.
# At PCLK=10 MHz hardware produces ~10 fps. JPEG ~50-80 KB/frame.
# 10fps × 70KB = 700KB/s = 5.6 Mbps — within ESP32-S3 Wi-Fi TCP throughput.
CONFIG_VH_CAM_JPEG_QUALITY=25
# 2 frame buffers for CAMERA_GRAB_LATEST. 2 × 128KB = 256KB PSRAM.
CONFIG_VH_CAM_FB_COUNT=2

# ── Camera JPEG DMA buffer ─────────────────────────────────────────────────────
# VGA quality=25 JPEG = 50-90 KB. 128 KB covers worst-case.
# 2 × 128 KB = 256 KB total PSRAM for camera buffers.
CONFIG_CAMERA_JPEG_MODE_FRAME_SIZE_CUSTOM=y
CONFIG_CAMERA_JPEG_MODE_FRAME_SIZE=131072

# ── SPI (W25Q64 external flash) ───────────────────────────────────────────────
CONFIG_SPI_MASTER_IN_IRAM=y
```

## yy2/main/Kconfig.projbuild
```kconfig
menu "Scout Configuration"

    menu "WiFi 2.4 GHz (IoT mesh)"
        config SCOUT_WIFI_24G_SSID
            string "2.4 GHz SSID"
            default "localhost-ofc-dev0"
        config SCOUT_WIFI_24G_PASSWORD
            string "2.4 GHz Password"
            default "1994Far.?!1994Far.?!"
    endmenu

    menu "WiFi 5 GHz (Internet)"
        config SCOUT_WIFI_5G_SSID
            string "5 GHz SSID"
            default "Pr.Kothsv."
        config SCOUT_WIFI_5G_PASSWORD
            string "5 GHz Password"
            default "ProfessorK!"
    endmenu

    menu "Telegram"
        config SCOUT_TG_BOT_TOKEN
            string "Bot Token"
            default "8162927459:AAFwcal9v645Xt8iwELQQXhv4tfZaXqfmWU"
        config SCOUT_TG_GROUP_ID
            string "Group Chat ID (yyy group)"
            default "-1003943316480"
        config SCOUT_TG_THREAD_ID
            int "SecBridge Thread ID"
            default 2
    endmenu

    menu "S3 Vision Hub (yy1)"
        config SCOUT_S3_IP
            string "S3 IP address on 2.4G network"
            default "192.168.39.157"
        config SCOUT_S3_HTTP_PORT
            int "S3 HTTP port"
            default 80
        config SCOUT_S3_USER
            string "S3 admin username"
            default "tenten"
        config SCOUT_S3_PASS
            string "S3 admin password"
            default "1234"
    endmenu

    menu "Schedule"
        config SCOUT_SCHEDULE_START_HOUR
            int "Active schedule start (hour, 24h)"
            default 9
        config SCOUT_SCHEDULE_END_HOUR
            int "Active schedule end (hour, 24h)"
            default 19
    endmenu

    menu "Telemetry"
        config SCOUT_TELEMETRY_PORT
            int "Telemetry HTTP server port (on 2.4G)"
            default 8080
    endmenu

endmenu
```
