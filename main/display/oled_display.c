/**
 * @file oled_display.c
 * @brief SSD1306 128x32 OLED driver — page-mode rendering with 6x8 font.
 *
 * The SSD1306 is driven via the shared I2C bus in page addressing mode.
 * A 512-byte framebuffer (4 pages × 128 columns) is maintained in SRAM
 * and flushed to the device on each update call.
 *
 * Font: 5x8 pixel glyphs (column-major, LSB at top) with a 1-column spacer.
 * Characters 0x20-0x7E are supported (95 printable ASCII).
 */
#include "oled_display.h"
#include "i2c_bus.h"
#include "ov3660_s3_n16r8.h"
#include "esp_log.h"
#include "freertos/FreeRTOS.h"
#include "freertos/task.h"
#include <string.h>
#include <stdio.h>

static const char *TAG = "oled";

#define OLED_WIDTH   128
#define OLED_PAGES     4    /* 4 pages × 8px = 32px height */
#define OLED_FONT_W    6    /* 5px glyph + 1px spacer */
#define OLED_COLS_PER_LINE (OLED_WIDTH / OLED_FONT_W)  /* 21 chars/line */

static i2c_master_dev_handle_t s_dev = NULL;
static uint8_t s_fb[OLED_PAGES][OLED_WIDTH];   /* Framebuffer */

/* ── Embedded 5x8 font (ASCII 0x20-0x7E, column-major, LSB=top) ──────────── */
static const uint8_t s_font[95][5] = {
    {0x00,0x00,0x00,0x00,0x00}, /* ' ' */
    {0x00,0x00,0x5F,0x00,0x00}, /* '!' */
    {0x00,0x07,0x00,0x07,0x00}, /* '"' */
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    {0x10,0x08,0x08,0x10,0x08}, /* '~' */
};

/* ── Low-level SSD1306 helpers ────────────────────────────────────────────── */

static esp_err_t oled_cmd(uint8_t cmd)
{
    uint8_t buf[2] = {0x00, cmd};  /* 0x00 = command byte prefix */
    return i2c_master_transmit(s_dev, buf, 2, 50);
}

static void oled_flush_page(uint8_t page)
{
    /* Set page address */
    oled_cmd(0xB0 | page);
    oled_cmd(0x00);  /* Column start low nibble */
    oled_cmd(0x10);  /* Column start high nibble */

    /* Send 128 pixel columns in one I2C burst */
    uint8_t buf[OLED_WIDTH + 1];
    buf[0] = 0x40;  /* Data byte prefix */
    memcpy(&buf[1], s_fb[page], OLED_WIDTH);
    i2c_master_transmit(s_dev, buf, sizeof(buf), 200);
}

/* ── Public API ───────────────────────────────────────────────────────────── */

esp_err_t oled_display_init(void)
{
    i2c_master_bus_handle_t bus = i2c_bus_get_handle();
    if (!bus) {
        ESP_LOGE(TAG, "I2C bus not initialized.");
        return ESP_ERR_INVALID_STATE;
    }

    i2c_device_config_t dev_cfg = {
        .dev_addr_length = I2C_ADDR_BIT_LEN_7,
        .device_address  = BOARD_SSD1306_I2C_ADDR,
        .scl_speed_hz    = BOARD_SENSOR_I2C_FREQ,
    };
    esp_err_t ret = i2c_master_bus_add_device(bus, &dev_cfg, &s_dev);
    if (ret != ESP_OK) {
        ESP_LOGE(TAG, "Add device failed: %s", esp_err_to_name(ret));
        return ret;
    }

    vTaskDelay(pdMS_TO_TICKS(10));

    /* Initialization sequence for 128x32 SSD1306 */
    const uint8_t init_cmds[] = {
        0xAE,       /* Display OFF */
        0xD5, 0x80, /* Clock divide ratio / oscillator frequency */
        0xA8, 0x1F, /* Multiplex ratio: 32 lines (0x1F = 31) */
        0xD3, 0x00, /* Display offset: 0 */
        0x40,       /* Start line: 0 */
        0x8D, 0x14, /* Charge pump: enable */
        0x20, 0x00, /* Memory mode: horizontal */
        0xA1,       /* Segment remap: col 127 = SEG0 */
        0xC8,       /* COM scan: remapped */
        0xDA, 0x02, /* COM pins: sequential, no remap (for 32-height) */
        0x81, 0xCF, /* Contrast */
        0xD9, 0xF1, /* Pre-charge period */
        0xDB, 0x40, /* VCOMH deselect level */
        0xA4,       /* Entire display: follow RAM */
        0xA6,       /* Normal (not inverted) */
        0xAF,       /* Display ON */
    };
    for (size_t i = 0; i < sizeof(init_cmds); i++) {
        if (oled_cmd(init_cmds[i]) != ESP_OK) {
            ESP_LOGW(TAG, "Init cmd 0x%02X failed.", init_cmds[i]);
        }
    }

    memset(s_fb, 0, sizeof(s_fb));
    for (uint8_t p = 0; p < OLED_PAGES; p++) oled_flush_page(p);

    ESP_LOGI(TAG, "SSD1306 128x32 initialized.");
    return ESP_OK;
}

void oled_display_clear(void)
{
    memset(s_fb, 0, sizeof(s_fb));
    for (uint8_t p = 0; p < OLED_PAGES; p++) oled_flush_page(p);
}

void oled_display_set_line(uint8_t line, const char *text)
{
    if (!s_dev || !text || line >= OLED_PAGES) return;

    uint8_t page = line;
    int col = 0;

    /* Render characters into framebuffer page */
    for (int i = 0; i < OLED_COLS_PER_LINE && text[i] != '\0'; i++) {
        uint8_t c = (uint8_t)text[i];
        if (c < 0x20 || c > 0x7E) c = 0x20;  /* Unsupported -> space */
        const uint8_t *glyph = s_font[c - 0x20];
        for (int g = 0; g < 5; g++) {
            if (col < OLED_WIDTH) s_fb[page][col++] = glyph[g];
        }
        if (col < OLED_WIDTH) s_fb[page][col++] = 0x00;  /* 1px spacer */
    }
    /* Blank remainder */
    while (col < OLED_WIDTH) s_fb[page][col++] = 0x00;

    oled_flush_page(page);
}

void oled_display_update(const telemetry_t *t)
{
    if (!s_dev || !t) return;

    char line[24];

    /* Line 0: System status / IP */
    if (t->wifi_connected) {
        snprintf(line, sizeof(line), "%-21s", t->wifi_ip);
    } else {
        snprintf(line, sizeof(line), "WiFi connecting...   ");
    }
    oled_display_set_line(0, line);

    /* Line 1: T, H, P */
    snprintf(line, sizeof(line), "T:%.1fC H:%.0f%% P:%.0f",
             t->temp_c, t->humidity_pct, t->pressure_hpa);
    oled_display_set_line(1, line);

    /* Line 2: CO, NH3, Lux */
    snprintf(line, sizeof(line), "CO:%.1f NH3:%.1f L:%d",
             t->co_ppm, t->nh3_ppm, (int)t->lux);
    oled_display_set_line(2, line);

    /* Line 3: Gas status + alarm (keep within 21 chars) */
    snprintf(line, sizeof(line), "%-10.10s %s",
             t->gas_status_str,
             t->alarm_active ? "!! ALARM" : "OK");
    oled_display_set_line(3, line);
}
